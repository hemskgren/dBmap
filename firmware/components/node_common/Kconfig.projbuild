## firmware/components/node_common/Kconfig.projbuild
```kconfig
menu "dBmap node"

    config DBMAP_WIFI_SSID
        string "Wi-Fi SSID"
        default ""

    config DBMAP_WIFI_PASSWORD
        string "Wi-Fi password"
        default ""

    config DBMAP_HUB_HTTP_URL
        string "Hub bootstrap base URL"
        default "https://hub.local:8443"

    config DBMAP_BOOTSTRAP_TOKEN
        string "One-time bootstrap token (required for first provisioning)"
        default ""

    config DBMAP_HARDWARE_REVISION
        string "Hardware compatibility profile"
        default "generic"

    config DBMAP_FIRMWARE_VERSION
        string "Firmware version"
        default "0.1.4"

    config DBMAP_NTP_SERVER
        string "Network time server"
        default "se.pool.ntp.org"

    config DBMAP_NODE_TYPE_OUTPUT
        bool "This firmware is ESP-Output"
        default y

    menu "Diagnostics (D1, RAM-only)"

        config DBMAP_DIAG_ENABLED
            bool "Include optional diag object on health/keepalive"
            default y
            help
                When enabled, health/keepalive may include a compact diag object.
                Defaults can later be overridden by Desired payload.diag when
                configuration sync bumps config_version. Counters stay in RAM only.

        config DBMAP_DIAG_RSSI_DEGRADED_DBM
            int "RSSI degraded threshold (dBm), for future health rules"
            range -100 -30
            default -80
            depends on DBMAP_DIAG_ENABLED
            help
                Local default only until Hub Desired payload.diag can override it.
                Not published on the wire in D1.

        config DBMAP_DIAG_COUNTER_SATURATE
            int "Maximum value for RAM diag counters"
            range 1 65535
            default 999
            depends on DBMAP_DIAG_ENABLED

    endmenu

    menu "Network retry backoff"

        config DBMAP_BACKOFF_MQTT_INITIAL_MS
            int "MQTT initial reconnect delay (ms)"
            range 200 10000
            default 1000

        config DBMAP_BACKOFF_MQTT_MAX_MS
            int "MQTT maximum reconnect delay (ms)"
            range 1000 300000
            default 60000

        config DBMAP_BACKOFF_MQTT_STABLE_MS
            int "MQTT stable time before backoff reset (ms)"
            range 0 300000
            default 30000
            help
                0 resets backoff immediately on CONNECT. Non-zero waits for the
                connection to remain up this long before clearing the progression.

        config DBMAP_BACKOFF_WIFI_INITIAL_MS
            int "Wi-Fi initial reconnect delay (ms)"
            range 200 10000
            default 1000

        config DBMAP_BACKOFF_WIFI_MAX_MS
            int "Wi-Fi maximum reconnect delay (ms)"
            range 1000 300000
            default 30000

        config DBMAP_BACKOFF_HTTPS_INITIAL_MS
            int "HTTPS Desired initial retry delay (ms)"
            range 200 10000
            default 1000

        config DBMAP_BACKOFF_HTTPS_MAX_MS
            int "HTTPS Desired maximum retry delay (ms)"
            range 1000 300000
            default 60000

    endmenu

endmenu
```

## firmware/components/output_audio/Kconfig
```kconfig
menu "dBmap Output audio (MAX98357 + MP3)"

config DBMAP_AUDIO_I2S_BCLK_GPIO
    int "MAX98357 BCLK GPIO"
    range 0 39
    default 26

config DBMAP_AUDIO_I2S_WS_GPIO
    int "MAX98357 LRC / WS GPIO"
    range 0 39
    default 25

config DBMAP_AUDIO_I2S_DOUT_GPIO
    int "MAX98357 DIN GPIO (I2S DOUT)"
    range 0 39
    default 22

config DBMAP_AUDIO_SD_MODE_GPIO
    int "MAX98357 SD_MODE GPIO (-1 = leave floating / always on)"
    range -1 39
    default -1

endmenu
```

## firmware/ear_components/ear_mic/Kconfig
```kconfig
menu "dBmap Ear microphone"
    depends on DBMAP_NODE_TYPE_EAR

    choice DBMAP_EAR_MIC_MODEL
        prompt "Microphone model (one per Ear image)"
        default DBMAP_EAR_MIC_MODEL_INMP441
        help
            Each Ear firmware image is built for exactly one microphone model.
            Additional models can be added later without mixing types on one device.

        config DBMAP_EAR_MIC_MODEL_INMP441
            bool "INMP441 (I2S MEMS)"
    endchoice

    config DBMAP_EAR_MIC_SAMPLE_RATE_HZ
        int "Capture sample rate (Hz)"
        range 8000 48000
        default 16000

    config DBMAP_EAR_MIC_WINDOW_MS
        int "Measurement window (ms)"
        range 100 5000
        default 1000
        help
            Latest window metrics are attached to hello/health/keepalive reported
            state (like wifi_rssi_dbm). There is no separate audio MQTT topic yet.

    config DBMAP_EAR_MIC_I2S_BCLK_GPIO
        int "I2S BCLK GPIO (UNVERIFIED placeholder)"
        range 0 48
        default 4
        help
            Shared bit clock for all INMP441s. Placeholder only — see
            docs/device-wiring-and-pinout.md. Confirm free GPIOs on the board
            before treating this map as verified.

    config DBMAP_EAR_MIC_I2S_WS_GPIO
        int "I2S WS / LRCLK GPIO (UNVERIFIED placeholder)"
        range 0 48
        default 5
        help
            Shared word select for all INMP441s.

    config DBMAP_EAR_MIC_I2S_DIN_GPIO
        int "I2S DIN0 GPIO for mic 0 (+ reserved mic 1)"
        range 0 48
        default 6
        help
            First data line. Mic index 0 uses the left slot (L/R to GND) today.
            Mic index 1 can share this DIN later (L/R to VDD). Indexes are
            0-based.

    config DBMAP_EAR_MIC_I2S_DIN1_GPIO
        int "I2S DIN1 GPIO for reserved mic 2+3 (-1 unused)"
        range -1 48
        default 7
        help
            Reserved second data line for mic indexes 2 (left) and 3 (right).
            Not read by the current single-mic capture path; keep the pin free
            when wiring a 4-mic Ear.

    config DBMAP_EAR_MIC_I2S_MCLK_GPIO
        int "I2S MCLK GPIO (-1 unused)"
        range -1 48
        default -1

    config DBMAP_EAR_MIC_L0
        bool "Compute L0 features per analysis window"
        default y
        help
            Run the Phase A L0 acoustic measurement library on each completed
            1 s analysis window. PCM for L0 is double-buffered in SPIRAM so
            I2S capture is not blocked by analysis. L0 is not used by the RMS
            activity detector. Results are exposed via get_l0_window for
            Observation-side interval aggregation and optional serial diag.
            Disable to reclaim SPIRAM (~2 × window PCM) when L0 is unused.

    config DBMAP_EAR_MIC_BACKGROUND
        bool "Iteration 1: rolling background RMS on Reported State"
        default y
        help
            Maintain a rolling RMS history and attach audio.microphones[i].background
            on hello/health/keepalive. Independent of Observation/MQTT. Read-only
            on publish. Disable to reclaim a few KB of static RAM.

    config DBMAP_EAR_MIC_BACKGROUND_WINDOW_MS
        int "Background RMS rolling window (ms)"
        depends on DBMAP_EAR_MIC_BACKGROUND
        range 10000 600000
        default 180000
        help
            Samples older than this duration are outside the Reported State
            profile (snapshot time-filters; ring may also drop on insert).

    config DBMAP_EAR_MIC_BACKGROUND_BOOT_SETTLE_MS
        int "Exclude background samples this long after I2S enable (ms)"
        depends on DBMAP_EAR_MIC_BACKGROUND
        range 0 120000
        default 5000
        help
            Reuses the same startup-settle idea as the activity detector
            (ms_since_i2s_enable). Also excludes window_seq == 1.

endmenu
```

## firmware/products/dbmap/ear/ae_runtime/Kconfig
```kconfig
menu "dBmap Audio Engine"

    config DBMAP_EAR_AUDIO_ENGINE
        bool "Enable Audio Engine device path (M4)"
        default y
        depends on DBMAP_EAR_MIC_L0
        help
            When enabled, ae_device_poll() is the sole consumer of
            sp_mic_take_window_job from the observation task. AE starts
            independently; Ear owns Candidate Engine startup and registers
            ce_on_signature as an AE listener. Existing activity detection
            and Observation MQTT are unchanged.
            Placement under products/dbmap/ear is temporary (§0.9).

    config DBMAP_EAR_AE_DIAG
        bool "Audio Engine controlled diagnostic logging"
        default n
        depends on DBMAP_EAR_AUDIO_ENGINE
        help
            Periodic ESP_LOGI of AE counters (not every window), including
            SP overwrite events vs sequence gaps.
            Enable for bench verification of PCM/channel alignment.

    config DBMAP_EAR_AE_DIAG_EVERY_N
        int "AE diag log every N successful signature publishes"
        depends on DBMAP_EAR_AE_DIAG
        range 1 120
        default 10

endmenu
```
