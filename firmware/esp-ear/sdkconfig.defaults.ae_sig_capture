## firmware/platform/audio/Kconfig
```kconfig
menu "Sensor Platform audio analysis"

    config SP_MIC_PCM_RETAIN
        bool "Retain analysis PCM windows (SPIRAM double-buffer)"
        default n
        help
            Keep completed analysis windows as double-buffered SPIRAM PCM for
            every live microphone channel (1..SP_MIC_COUNT_MAX from NVS
            mic_count). Independent of product Observation policy.
            Products that need L0/L1/L2 typically select this with SP_AUDIO_L0.

    config SP_AUDIO_L0
        bool "L0 acoustic measurements (band energy / RMS / crest)"
        default n
        help
            Compile Platform L0 DSP (sp_acoustic_l0). Host-testable combined-scene
            measurements. Does not include product Observation or AE policy.

    config SP_AUDIO_L1
        bool "L1 spectral features (FFT centroid / bandwidth / flatness)"
        default n
        depends on SP_AUDIO_L0
        help
            Compile Platform L1 DSP (sp_acoustic_l1). Requires L0. Uses a static
            FFT workspace (~22.5 KiB).

    config SP_AUDIO_L2
        bool "L2 acoustic dynamics (flux / envelope / dominant delta)"
        default n
        depends on SP_AUDIO_L1
        help
            Compile Platform L2 DSP (sp_acoustic_l2) and enable the fused L1+L2
            FFT path. Requires L1. Invalid without L1 (Kconfig dependency).

endmenu
```

## firmware/products/dbmap/ear/ae_runtime/Kconfig
```kconfig
menu "dBmap Audio Engine"

    config DBMAP_EAR_AUDIO_ENGINE
        bool "Enable Audio Engine device path (M4)"
        default y
        depends on DBMAP_EAR_MIC_L0
        help
            When enabled, ae_device_poll() is the sole consumer of
            sp_mic_take_window_job from the observation task. AE starts
            independently; Ear owns Candidate Engine startup and registers
            ce_on_signature as an AE listener. Existing activity detection
            and Observation MQTT are unchanged.
            Placement under products/dbmap/ear is temporary (§0.9).

    config DBMAP_EAR_AE_DIAG
        bool "Audio Engine controlled diagnostic logging"
        default n
        depends on DBMAP_EAR_AUDIO_ENGINE
        help
            Periodic ESP_LOGI of AE counters (not every window), including
            SP overwrite events vs sequence gaps.
            Enable for bench verification of PCM/channel alignment.

    config DBMAP_EAR_AE_DIAG_EVERY_N
        int "AE diag log every N successful signature publishes"
        depends on DBMAP_EAR_AE_DIAG
        range 1 120
        default 10

    config DBMAP_EAR_AE_SIG_CAPTURE
        bool "AE signature CSV capture (AS-001 calibration)"
        default n
        depends on DBMAP_EAR_AUDIO_ENGINE
        help
            Bounded observational capture of AE signature features to UART as
            AE_SIG_CSV lines for host comparison with AS-001 signatures.csv.
            Does not change AE feature math, CE, P2, Observation, or MQTT.
            Symbol default is n; EAR sdkconfig.defaults enables it (y).
            Hub List config key: EAR_AE_SIG_CAPTURE.
            Reported in capabilities.observation as AE_SIG_CAPTURE true/false.

endmenu
```

## firmware/products/dbmap/ear/ear_acoustic/Kconfig
```kconfig
menu "dBmap Ear acoustic analysis"
    depends on DBMAP_NODE_TYPE_EAR

    config DBMAP_EAR_MIC_L0
        bool "Enable EAR L0 analysis path (selects Platform PCM + L0 DSP)"
        default y
        select SP_MIC_PCM_RETAIN
        select SP_AUDIO_L0
        help
            EAR product enable for L0 analysis. Selects Platform SPIRAM PCM
            retention (SP_MIC_PCM_RETAIN) and Platform L0 DSP (SP_AUDIO_L0).
            I2S capture is not blocked by analysis. Not used by the RMS
            activity detector. Disable to reclaim SPIRAM when unused.
            Microphone hardware options live under Sensor Platform microphone
            (SP_MIC_*); this option only enables the product analysis path.

endmenu
```
